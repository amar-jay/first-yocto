## conf/layer.conf
```bitbake
# We have a conf and classes directory, add to BBPATH
BBPATH .= ":${LAYERDIR}"

# We have recipes-* directories, add to BBFILES
BBFILES += "${LAYERDIR}/recipes-*/*/*.bb \
            ${LAYERDIR}/recipes-*/*/*.bbappend"

BBFILE_COLLECTIONS += "meta-manan"
BBFILE_PATTERN_meta-manan = "^${LAYERDIR}/"
BBFILE_PRIORITY_meta-manan = "6"

LAYERDEPENDS_meta-manan = "core"
LAYERSERIES_COMPAT_meta-manan = "walnascar"


IMAGE_INSTALL:append = " python3 python3-pip go htop curl wget packagegroup-gstreamer"
```
